## drivers/staging/android/Kconfig
```kconfig
# SPDX-License-Identifier: GPL-2.0
config ASHMEM
	bool "Enable the Anonymous Shared Memory Subsystem"
	depends on SHMEM
	select ANDROID_STAGING
	help
	  The ashmem subsystem is a new shared memory allocator, similar to
	  POSIX SHM but with different behavior and sporting a simpler
	  file-based API.

	  It is, in theory, a good memory allocator for low-memory devices,
	  because it can discard shared memory units when under memory pressure.

config ASHMEM_RUST
	bool "Use the Rust implementation of Ashmem"
	depends on ASHMEM && RUST

config ASHMEM_C
	def_bool ASHMEM && !ASHMEM_RUST

config ANDROID_LOGGER
	tristate "Android log driver"
	help
	  This adds support for system-wide logging using four log buffers.

	  These are:

	      1: main
	      2: events
	      3: radio
	      4: system

	  Log reading and writing is performed via normal Linux reads and
	  optimized writes. This optimization avoids logging having too
	  much overhead in the system.
```
